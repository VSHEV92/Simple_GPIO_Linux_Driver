/include/ "system-conf.dtsi"
/delete-node/ &axi_gpio_0;

&amba_pl {
    my_gpio_0: gpio@41200000 {
        #gpio-cells = <3>;
        clock-names = "s_axi_aclk";
        clocks = <&clkc 15>;
        compatible = "vshev92,my_xlnx_gpio";
        reg = <0x41200000 0x10000>;
        gpio-width = <0x4>;
    };
};


